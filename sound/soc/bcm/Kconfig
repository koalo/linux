## sound/soc/bcm/Kconfig
```kconfig
config SND_BCM2708_SOC_I2S
	tristate "SoC Audio support for the Broadcom BCM2708 I2S module"
	depends on MACH_BCM2708
	select REGMAP_MMIO
	select SND_SOC_DMAENGINE_PCM
	select SND_SOC_GENERIC_DMAENGINE_PCM
	help
	  Say Y or M if you want to add support for codecs attached to
	  the BCM2708 I2S interface. You will also need
	  to select the audio interfaces to support below.

config SND_BCM2708_SOC_HIFIBERRY_MINI
        tristate "Support for HifiBerry Mini"
        depends on SND_BCM2708_SOC_I2S
        select SND_SOC_PCM5102A
        help
         Say Y or M if you want to add support for HifiBerry Mini.

config SND_BCM2708_SOC_RPI_CODEC_MBED
		tristate "Support for AudioCODEC for mbed (TLV320AIC23B)"
		depends on SND_BCM2708_SOC_I2S
		select SND_SOC_TLV320AIC23
		help
		  Say Y if you want to add support for AudioCODEC for mbed (TLV320AIC23B)
```
